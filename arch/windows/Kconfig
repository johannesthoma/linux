## arch/windows/Kconfig
```kconfig
# SPDX-License-Identifier: GPL-2.0

menu "Windows and ReactOS-specific options"

config WINDOWS
	def_bool y

config HZ
        int "Clock frequency."
        default 1000

# TODO: those should depend on WINDOWS_ARCH
config 64BIT
	def_bool n

config 32BIT
	def_bool y

config MMU
	def_bool n

config HUGETLB_PAGE
	def_bool n

config KALLSYMS
	def_bool n

config HAVE_FUNCTION_DESCRIPTORS
	def_bool n

config GENERIC_CALIBRATE_DELAY
	def_bool y

config GENERIC_ATOMIC64
	def_bool y

config GENERIC_HWEIGHT
	def_bool y

config CRYPTO_LIB_BLAKE2S_GENERIC
	def_bool y

config GENERIC_SCHED_CLOCK
	def_bool y

config GENERIC_IRQ_SHOW
	def_bool y

config THREAD_INFO_IN_TASK
	def_bool y

config PREEMPT_BUILD
	def_bool y

config PREEMPT
	def_bool y

config PREEMPT_COUNT
	def_bool y

config PREEMPTION
	def_bool y

# Windows does the (SMP-)scheduling for us, no need to set this
config SMP
	def_bool n

endmenu
```
